/ {
    chosen {
        zmk,kscan = &kscan0;
    };

    kscan0: kscan {
        compatible = "zmk,kscan-gpio-direct";

        gpios = <&pro_micro 47 (GPIO_ACTIVE_HIGH)>,
                <&pro_micro 2  (GPIO_ACTIVE_HIGH)>;
    };
};