// 文件路径: config/hudada_page_turner/hudada_page_turner.overlay

#include <dt-bindings/zmk/matrix_transform.h>

/ {
    chosen {
        zmk,kscan = &kscan0;
    };

    kscan0: kscan {
        compatible = "zmk,kscan-gpio-matrix";
        label = "HUDADA_PAGETURNER";

        // 对于只有两个按键的设备，我们将其模拟成一个1x2的矩阵
        // 一个按键定义为行，另一个定义为列
        
        // !!! 请将这里的 17 和 20 替换成你实际使用的引脚编号 !!!
        // 假设“上翻页”键连接到 nice!nano v2 的 D10 (P0.17)
        row-gpios = <&gpio0 47 (GPIO_ACTIVE_LOW | GPIO_PULL_UP)>;
        
        // 假设“下翻页”键连接到 nice!nano v2 的 D9 (P0.20)
        col-gpios = <&gpio0 2 (GPIO_ACTIVE_LOW | GPIO_PULL_UP)>;
    };
};