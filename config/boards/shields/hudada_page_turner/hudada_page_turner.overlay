/*
 * Copyright (c) 2024 The ZMK Contributors
 * SPDX-License-Identifier: MIT
 */

/ {
    chosen {
        zmk,kscan = &kscan0;
    };

    kscan0: kscan {
        compatible = "zmk,kscan-gpio-direct";
        
        /* 使用 nice!nano v2 上确定可用的引脚 (D10 和 D9)
         * 这是解决本次错误的最终修正。
         */
        input-gpios
            = <&pro_micro 10 (GPIO_ACTIVE_LOW | GPIO_PULL_UP)> // 第一个按键
            , <&pro_micro 9 (GPIO_ACTIVE_LOW | GPIO_PULL_UP)>; // 第二个按键
    };
};