## config/boards/shields/hudada_page_turner/Kconfig.defconfig
```kconfig
# Copyright (c) 2024 The ZMK Contributors
# SPDX-License-Identifier: MIT

if SHIELD_HUDADA_PAGE_TURNER

config ZMK_KEYBOARD_NAME
    default "HudadaPageTurner"

endif
```

## config/boards/shields/hudada_page_turner/Kconfig.shield
```kconfig
config SHIELD_HUDADA_PAGE_TURNER
    def_bool $(shields_list_contains,hudada_page_turner)
```

## config/boards/shields/hudada_page_turner/dts/bindings/behaviors/hudada_page_turner,behavior-page-down.yaml
```yaml
description: Page Down Behavior
compatible: "hudada_page_turner,behavior-page-down"
```

## config/boards/shields/hudada_page_turner/dts/bindings/behaviors/hudada_page_turner,behavior-page-turner-command.yaml
```yaml
description: |
  Page Turner Command Behavior
  Sends a single consumer control code.

compatible: "hudada_page_turner,behavior-page-turner-command"

binding-cells: 1

include: []
```

## config/west.yml
```yaml
# 文件路径: config/west.yml
manifest:
  remotes:
    - name: zmkfirmware
      url-base: https://github.com/zmkfirmware
    - name: zzeneg
      url-base: https://github.com/zzeneg
  projects:
    - name: zmk
      remote: zmkfirmware
      revision: main  # <--- [关键修正] 改回 'main'
      import: app/west.yml
    - name: zmk-raw-hid
      remote: zzeneg
      revision: main
  self:
    path: config
```
